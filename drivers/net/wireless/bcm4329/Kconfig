## drivers/net/wireless/bcm4329/Kconfig
```kconfig
config BCM4329
	default m
	tristate "Broadcom 4329 WLAN Driver"
	select WIRELESS_EXT
	select WEXT_CORE
	select WEXT_PROC
	select WEXT_PRIV
	---help---
		Select this option to build Broadcom 4329 WLAN driver
```
